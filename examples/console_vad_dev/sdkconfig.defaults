## examples/console_vad_dev/sdkconfig.defaults
```kconfig
# ESP-IDF sdkconfig defaults
# Example: esp32-p4-idf-fireredvad / examples/console_vad_dev
# Hardware-specific options must match the target board and ESP-IDF version.
# Entries and values are preserved; sections are ordered for easier review.

# ============================================================================
# ESP32-P4 Hardware Target Configuration
# ============================================================================
CONFIG_IDF_TARGET="esp32p4"
CONFIG_ESP32P4_SELECTS_REV_LESS_V3=y

# ============================================================================
# Flash Configuration (32 MB QIO Mode)
# ============================================================================
CONFIG_ESPTOOLPY_FLASHMODE_QIO=y
CONFIG_ESPTOOLPY_FLASHSIZE_32MB=y

# ============================================================================
# Partition Table
# ============================================================================
CONFIG_PARTITION_TABLE_CUSTOM=y
CONFIG_PARTITION_TABLE_CUSTOM_FILENAME="partitions.csv"
CONFIG_PARTITION_TABLE_FILENAME="partitions.csv"

# ============================================================================
# PSRAM Configuration (Required for FireVAD models)
# ============================================================================
CONFIG_SPIRAM=y
CONFIG_SPIRAM_USE_MALLOC=y

# ============================================================================
# Compiler Optimization (CRITICAL for Performance!)
# ============================================================================
CONFIG_COMPILER_OPTIMIZATION_ASSERTIONS_DISABLE=y
CONFIG_COMPILER_OPTIMIZATION_PERF=y
CONFIG_ESP_TASK_WDT_TIMEOUT_S=10

# ============================================================================
# FreeRTOS Configuration
# ============================================================================
CONFIG_FREERTOS_HZ=1000

# ============================================================================
# Power Management
# ============================================================================
CONFIG_PM_ENABLE=y

# ============================================================================
# Console/UART Configuration
# ============================================================================
CONFIG_ESP_CONSOLE_UART_BAUDRATE=115200
CONFIG_ESP_CONSOLE_UART_NUM=0

# ============================================================================
# Logging Configuration
# ============================================================================
CONFIG_LOG_DEFAULT_LEVEL_INFO=y
CONFIG_LOG_MAXIMUM_LEVEL_VERBOSE=y

# ============================================================================
# I2S Configuration
# ============================================================================
CONFIG_I2S_ENABLE_DEBUG_LOG=n

# ============================================================================
# SPIFFS Configuration (16MB partition requires larger page size)
# ============================================================================
CONFIG_SPIFFS_MAX_PARTITIONS=3
CONFIG_SPIFFS_OBJ_NAME_LEN=64
CONFIG_SPIFFS_PAGE_SIZE=512
CONFIG_SPIFFS_USE_MAGIC=y
CONFIG_SPIFFS_USE_MAGIC_LENGTH=y

# ============================================================================
# ESP-DSP Optimization (CRITICAL: Enable PIE/SIMD acceleration!)
# ============================================================================
CONFIG_DSP_ANSI=n
CONFIG_DSP_OPTIMIZED=y

# ============================================================================
# FireVAD Component Configuration
# ============================================================================
CONFIG_FIREVAD_ENABLE_AUDIO=y
```
